## boards/shields/tako/Kconfig.defconfig
```kconfig
if SHIELD_TAKO_LEFT

config ZMK_KEYBOARD_NAME
    default "tako"

config ZMK_SPLIT_ROLE_CENTRAL
    default y

endif # SHIELD_TAKO_LEFT

if SHIELD_TAKO_LEFT || SHIELD_TAKO_RIGHT

config ZMK_SPLIT
    default y

endif # SHIELD_TAKO_LEFT || SHIELD_TAKO_RIGHT
```

## config/west.yml
```yaml
manifest:
  defaults:
    revision: v0.3
  remotes:
    - name: zmkfirmware
      url-base: https://gitee.com/gofranchang
    - name: petejohanson
      url-base: https://github.com/petejohanson
    - name: GofranChang
      url-base: https://github.com/GofranChang
  projects:
    - name: zmk
      remote: petejohanson
      revision: core/move-to-zephyr-4-1
      import: app/west.yml
    - name: analog-matrix-module
      remote: GofranChang
      revision: tako_dbg
  self:
    path: config
```
